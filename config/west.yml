## config/west.yml
```yaml
manifest:
  remotes:
    - name: moergo-sc
      url-base: https://github.com/moergo-sc
    - name: dhruvinsh
      url-base: https://github.com/dhruvinsh
    - name: urob
      url-base: https://github.com/urob
  projects:
    - name: zmk
      remote: moergo-sc
      revision: main
      import: app/west.yml
    - name: zmk-tri-state
      remote: dhruvinsh
      revision: main
    - name: zmk-unicode
      remote: urob
      revision: v0.3
  self:
    path: config
```
